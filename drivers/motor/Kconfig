## drivers/motor/Kconfig
```kconfig
config MSM_VIBRATOR
	tristate "MSM_VIBRATOR"
	default n
	help
	  Say Y to enable MSM_VIBRATOR support

config DC_MOTOR_PMIC
	tristate "DC_MOTOR_PMIC"
	default n
	help
	  Say Y to enable MOTOR DC drive by PMIC support

menuconfig SM5703_VIBRATOR
        tristate "SM5703_VIBRATOR"
        default n
        help
          Say Y to enable SM5703_VIBRATOR support.
#
# Motor devices configuration
#

comment "Motor configs"


config STEP_MOTOR_STSPIN220
	tristate "STSPIN220"
	default n
	help
          Say Y to enable STSPIN220 support
	  You will get supprot for that.

	  If unsure, say N.

config SS_VIBRATOR
	tristate "SS_VIBRATOR"
	default n
	help
	  Say Y to enable SAMSUNG VIBRATOR support
	  SS Vibrator
	  You will get supprot for that.

	  If unsure, say N.

config BOOST_POWER_SHARE
	bool "Boost Power Share"
	default n
	help
	  Say Y to enable Boost Power(5V) share.
```
